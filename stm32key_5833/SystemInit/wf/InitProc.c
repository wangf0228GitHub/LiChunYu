#include "InitProc.h"
#include "..\..\wf\ATA5833.h"
#include "..\..\..\..\WF_Device\wfDefine.h"
#include "..\..\..\..\WF_Device\stm32\wfSys.h"
#include "..\..\wf\Variables.h"
#include <stdlib.h>
#include "..\..\..\..\WF_Device\SPIROM.h"
#include "stm32l4xx_hal_flash.h"
#include "..\..\..\..\WF_Device\lcyIRDecode.h"
#include "..\..\..\..\WF_Device\lcyHash.h"
uint8_t sram[1024];
uint8_t eeprom[1024];
#ifdef ATA315
uint8_t ATA5833_eeprom[1024]=
{
	0x2A, 0x07, 0x02, 0x68, 0xDD, 0x72, 0x01, 0x97, //0x00��07
	0x00, 0x02, 0x00, 0x00, 0x00, 0xC9, 0x2E, 0x08, //0x08��0F
	0x03, 0x00, 0x00, 0x20, 0x01, 0x07, 0x00, 0x00, //0x10��17
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	0xFF, 0xFF, 0xFF, 0xFF, 0xFF, 0xFF, 0x77, 0x66, //0x3F8��3FF
};
#else
uint8_t ATA5833_eeprom[1024]=
{
	0x2A, 0x07, 0x02, 0x68, 0xDD, 0x72, 0x01, 0x42, //0x00��07
	0x00, 0x02, 0x00, 0x00, 0x00, 0xC9, 0x2E, 0x08, //0x08��0F
	0x03, 0x00, 0x00, 0x20, 0x01, 0x07, 0x00, 0x00, //0x10��17
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	0xFF, 0xFF, 0xFF, 0xFF, 0xFF, 0xFF, 0x77, 0x66, //0x3F8��3FF

};
#endif

void ATA583X_ReadParam()
{
	uint32_t i,addr;
	for(i=0;i<1024;i++)
	{
		ATA583X_ReadSRAM(i,1,&sram[i]);
	}
	for(i=0;i<1024;i++)
	{
		eeprom[i]=ATA583X_ReadEEPROM(i);
	}
}
void ATA583X_InitEEPROM()
{
	uint32_t i,x,seed,err;
	uint32_t addr;
	uint8_t data;		
	HAL_GPIO_WritePin(LED_GPIO_Port,LED_Pin,GPIO_PIN_SET);
	ATA583X_IDLEMode();	
	seed+=EEPSWOriginal.u32.psw1;
	seed+=EEPSWOriginal.u32.psw2;
	seed+=EEPSWOriginal.u32.psw3;
	srand(seed);
	err=0;
	for(i=0x0280;i<0x0400;i++)
	{
		ATA5833_eeprom[i]=rand();
	}
	for(i=0;i<16;i++)
		ATA5833_eeprom[EEPSWAddr+i]=EEPSW[i];
	for(i=0;i<1024;i++)
	{
		while(1)
		{			
			data=ATA5833_eeprom[i];
			ATA583X_WirteEEPROM(i,data);
			x=ATA583X_ReadEEPROM(i);
			if(x==data)
				break;
			else
			{
				err++;
				if(err>100)
				{
					ledFlash(200);
				}
				wfDelay_ms(10);
			}
		}
	}		
}
void InitEE(void)
{
	uint32_t i;
	uint8_t eedata[256];
	for(i=0;i<256;i++)
		eedata[i]=i+1;
	SPIROM_WriteArray(0,eedata,256);
	for(i=0;i<256;i++)
		eedata[i]=0;
	SPIROM_ReadArray(0,eedata,256);
	for(i=0;i<256;i++)
	{
		if(eedata[i]!=(uint8_t)(i+1))
		{
			ledFlash(100);
		}
	}


	SPIROM_WriteArray(eeprom_UpdateKey_Addr,(uint8_t*)eeprom_UpdateKey,16);
	for(i=0;i<16;i++)
		eedata[i]=0;
	SPIROM_ReadArray(eeprom_UpdateKey_Addr,eedata,16);
	for(i=0;i<16;i++)
	{
		if(eedata[i]!=(uint8_t)(i+1))
		{
			ledFlash(100);
		}
	}
}
void InitRenewTimes(void)
{
	uint32_t i;
	_RenewTimes RenewTimes;
	_RenewTimes readRenewTimes;
	for(i=0;i<8;i++)
		lcyHashIn[i]=EEPSW[i];
	lcyHashCalc(5+1);
	for(i=0;i<8;i++)
		RenewTimes.dataList[i]=lcyHashOut[i];
	STMFLASH_Write(0,&RenewTimes.data,1);
	wfFlash_ReadDoubleWords(0,&readRenewTimes.data,1);
	for(i=0;i<8;i++)
	{
		if(readRenewTimes.dataList[i]!=RenewTimes.dataList[i])
		{
			ledFlash(300);
		}
	}
}
